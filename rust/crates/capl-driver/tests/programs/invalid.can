variables {
  long counter = ;
}

on start {
  missing_function(1);
}
