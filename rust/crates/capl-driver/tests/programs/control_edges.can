variables {
  long total = 0;
  long i = 0;
  int enabled = 1;
}

long score(long n) {
  if (n < 0) return -1;
  if (n == 0) return 0;
  return n > 10 ? n * 2 : n + 10;
}

on start {
  total = 0;
  for (i = 0; i < 5; i++) {
    if (i == 2) continue;
    total += score(i);
  }
  while (enabled && total < 100) {
    total++;
    if (total > 90) break;
  }
  do { total--; } while (total > 95);
  switch (total) {
    case 95: total += 5; break;
    case 100: break;
    default: total = total ? total : -1;
  }
}

on key 'e' { enabled = enabled ? 0 : 1; }
