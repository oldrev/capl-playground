variables {
  const int RUNNING = 4;
  long samples[4];
  int64 total = 0;
  double factor = 2.0;
}

on start {
  samples[0] = 1;
  samples[3] = 3;
  total = samples[0] + samples[3];
  write("mode=%d total=%d factor=%.1f", RUNNING, total, factor);
}
