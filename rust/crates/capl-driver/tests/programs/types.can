enum Mode { OFF, RUNNING = 4, FAULT }

variables {
  long samples[4];
  int64 total = 0;
  double factor = 2.0;
}

on start {
  samples[0] = 1;
  samples[3] = 3;
  total = samples[0] + samples[3];
  write("mode=%d total=%d factor=%.1f", RUNNING, total, factor);
  switch (FAULT) { case OFF: write("off"); break; case RUNNING: write("run"); break; default: write("fault"); }
}
