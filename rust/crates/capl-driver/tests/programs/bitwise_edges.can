variables {
  dword bits = 0xF0F0;
  long values[3] = { 1, 2, 4 };
  long index = 0;
  long accumulator = 0;
}

on start {
  index = (index + 1) % 3;
  accumulator = (bits >> 4) & 0xFF;
  accumulator |= values[index];
  accumulator ^= (values[0] << 2);
  accumulator &= ~(values[1] - 1);
  if ((accumulator >= 0 && accumulator <= 255) || index == 2) {
    write("bits=%d", accumulator);
  }
}

on key 'b' {
  ++index;
  if (index >= 3) index = 0;
  values[index] = values[index] * 2;
}
